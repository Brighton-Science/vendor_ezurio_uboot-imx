## board/boundary/imx8mp_abiomed/Kconfig
```kconfig
if TARGET_IMX8MP_ABIOMED

config SYS_BOARD
	default "imx8mp_abiomed"

config SYS_VENDOR
	default "boundary"

config SYS_CONFIG_NAME
	default "imx8mp_abiomed"

source "board/boundary/common/Kconfig"

endif
```
